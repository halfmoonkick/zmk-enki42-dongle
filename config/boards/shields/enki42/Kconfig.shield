## config/boards/shields/enki42/Kconfig.shield
```kconfig
# Copyright (c) 2020 The ZMK Contributors
# SPDX-License-Identifier: MIT

config SHIELD_LILY58_LEFT
	def_bool $(shields_list_contains,Lily58_left_left)

config SHIELD_LILY58_RIGHT
	def_bool $(shields_list_contains,Lily58_left_right)

config SHIELD_LILY58_DONGLE
	def_bool $(shields_list_contains,Lily58_left_dongle)
```

## config/boards/shields/lily58/Kconfig.defconfig
```kconfig
# Copyright (c) 2020 The ZMK Contributors
# SPDX-License-Identifier: MIT

if SHIELD_LILY58_DONGLE

config ZMK_KEYBOARD_NAME
	default "Lily58 Dongle"
	
config ZMK_SPLIT_ROLE_CENTRAL
	default y

config ZMK_SPLIT
    	default y

endif

if SHIELD_LILY58_DONGLE || SHIELD_LILY58_RIGHT || SHIELD_LILY58_LEFT 

config ZMK_SPLIT
	default y
	
endif
```
