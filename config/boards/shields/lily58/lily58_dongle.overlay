/*
 * Copyright (c) 2020 The ZMK Contributors
 *
 * SPDX-License-Identifier: MIT
 */

#include "lily58.dtsi"

/ {
    chosen {
        zmk,kscan = &mock_kscan;
        zmk,matrix-transform = &default_transform;
    };

    mock_kscan: kscan_0 {
        compatible = "zmk,kscan-mock";
        columns = <0>;
        rows = <0>;
        events = <0>;
    };
};
